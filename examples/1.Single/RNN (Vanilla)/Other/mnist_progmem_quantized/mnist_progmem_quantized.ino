/*
  Trained via Tensorflow: 22 epochs | 472 parameters (bytes)
  Testing  accuracy: 0.9216 - loss: 0.2626
  Training accuracy: 0.9186 - loss: 0.2724

  Source: https://github.com/GiorgosXou/ATTiny85-MNIST-RNN-EEPROM
*/

#define NumberOf(arg) ((unsigned int) (sizeof (arg) / sizeof (arg [0]))) // calculates the number of layers (in this case 3)
#define _1_OPTIMIZE 0B11011010 // https://github.com/GiorgosXou/NeuralNetworks#define-macro-properties
#define _2_OPTIMIZE 0B00100100 // MULTIPLE_BIASES_PER_LAYER + int8_t quantization
#define Q_FLOAT_RANGE 2.0      // Our Float32 weights are in the range of [-1,1]
#define USE_RNN__NB            // Makes (vanilla)-RNN the core-architecture of your NeuralNetwork. (NB = NO_BACKPROP support)
#define SELU                   // Defines core activation-function of your NeuralNetwork.
#include <NeuralNetwork.h>


// Images of handwritten Numbers\Digits in byte form. 
const PROGMEM byte handwritten[4][28][28] = { 
{ // NUMBER: 4
    {0,0,0,0, 0,  0,  0,  0,  0,  0,  0,  0,  0,  0,  0,  0,  0,  0,  0,  0,  0,  0,  0,  0, 0,0,0,0},
    {0,0,0,0, 0,  0,  0,  0,  0,  0,  0,  0,  0,  0,  0,  0,  0,  0,  0,  0,  0,  0,  0,  0, 0,0,0,0},
    {0,0,0,0, 0,  0,  0,  0,  0,  0,  0,  0,  0,  0,  0,  0,  0,  0,  0,  0,  0,  0,  0,  0, 0,0,0,0},
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    {0,0,0,0, 0,  0,  0,  0,  0,  0,  0,  0,  0,  0,  0,  0,  0,  0,  0,  0,  0,  0,  0,  0, 0,0,0,0},
},
{ // NUMBER: 7
    {0,0,0,0, 0,  0,  0,  0,  0,  0,  0,  0,  0,  0,  0,  0,  0,  0,  0,  0,  0,  0,  0,  0, 0,0,0,0},
    {0,0,0,0, 0,  0,  0,  0,  0,  0,  0,  0,  0,  0,  0,  0,  0,  0,  0,  0,  0,  0,  0,  0, 0,0,0,0},
    {0,0,0,0, 0,  0,  0,  0,  0,  0,  0,  0,  0,  0,  0,  0,  0,  0,  0,  0,  0,  0,  0,  0, 0,0,0,0},
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    {0,0,0,0, 0,  0, 57,252,252,  0,  0,  0,  0,  0,  0,  0,  0,  0,  0,  0,  0,  0,  0,  0, 0,0,0,0},  
},
{ // NUMBER: 0
    {0,0,0,0, 0,  0,  0,  0,  0,  0,  0,  0,  0,  0,  0,  0,  0,  0,  0,  0,  0,  0,  0,  0, 0,0,0,0,},
    {0,0,0,0, 0,  0,  0,  0,  0,  0,  0,  0,  0,  0,  0,  0,  0,  0,  0,  0,  0,  0,  0,  0, 0,0,0,0,},
    {0,0,0,0, 0,  0,  0,  0,  0,  0,  0,  0,  0,  0,  0,  0,  0,  0,  0,  0,  0,  0,  0,  0, 0,0,0,0,},
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    {0,0,0,0, 0,  0,  0,  0,  0,  0,  0,  0,  0,  0,  0,  0,  0,  0,  0,  0,  0,  0,  0,  0, 0,0,0,0,}
},
{ // NUMBER: 3
    {0,0,0,0, 0,  0,  0,  0,  0,  0,  0,  0,  0,  0,  0,  0,  0,  0,  0,  0,  0,  0,  0,  0, 0,0,0,0},
    {0,0,0,0, 0,  0,  0,  0,  0,  0,  0,  0,  0,  0,  0,  0,  0,  0,  0,  0,  0,  0,  0,  0, 0,0,0,0},
    {0,0,0,0, 0,  0,  0,  0,  0,  0,  0,  0,  0,  0,  0,  0,  0,  0,  0,  0,  0,  0,  0,  0, 0,0,0,0},
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    {0,0,0,0, 0,  0,  0,  0,  0,  0,  0,  0,  0,  0,  0,  0,  0,  0,  0,  0,  0,  0,  0,  0, 0,0,0,0}, 
},
}; // ^^^^^^ (images*(rows*pixels)) = (4*(28*28)) = 3136 Bytes 


const PROGMEM int8_t biases[] = {
 -9  , 21 ,-8  ,-5  , 9  ,
  17 ,-42 ,-78 ,-1  , 0  ,-4  ,-12 ,-2  ,
 -78 , 1  ,-19 ,-35 , 118, 2  , 20 ,-127,-54 ,-30 ,
};

const PROGMEM int8_t weights[] = {
  // Layer 0 -> 1
  114, 38 ,-100, 5  ,-4  , 11 , 21 , 17 , 21 , 27 , 29 , 39 , 32 , 69, 48 , 56 , 22 , 16 , 12 , 1  , 11 ,-4  , 2  , 24 , 5  ,-20 , 41 ,-51 ,
  58 , 21 ,-57 ,-15 ,-14 ,
 -58 ,-6  , 4  ,-11 , 45 ,-4  ,-10 ,-15 ,-28 ,-15 ,-38 ,-25 , 25 ,-5 ,-3  ,-14 , 28 , 28 , 15 , 19 ,-1  ,-4  , 6  ,-46 ,-1  , 18 , 53 , 58 ,
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  29 ,-14 ,-64 ,-42 ,-97 ,

  // Layer 1 -> 2
 -18 , 49 , 92 , 40 ,-74 ,
  37 , 116, 36 , 47 ,-43 ,-34 , 14 ,-4  ,
 -117, 6  , 110,-125, 32 ,
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 -69 ,-18 , 36 ,-55 , 59 ,-49 , 29 , 94 ,

  // Layer 2 -> 3
 -62 ,-20 , 86 ,-74 ,-24 , 1  , 1  ,-15 ,
  114, 19 ,-29 , 38 , 24 , 0  , 6  ,-18 , 65 ,-33 ,
 -74 , 74 ,-29 , 34 ,-93 ,-107,-50 , 38 ,
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  18 , 19 , 38 ,-55 , 34 , 59 ,-1  , 10 ,-63 , 76 ,
};

const unsigned int layers[] = {28, 5, 8, 10};
float *output; // 4th layer's output(s)

unsigned long timestamp;


unsigned int maxOutput(){
  unsigned int maxi=0;
  for (unsigned int i = 0; i < 10; i++)
    if (output[i] > output[maxi])
      maxi = i;
  return maxi;
}


void setup()
{
  Serial.begin(9600);
  while (!Serial){ };

  // Creating a NeuralNetwork with pretrained Weights and Biases
  NeuralNetwork NN(layers, weights, biases, NumberOf(layers));
  //Goes through each image
  for (unsigned int image = 0; image < 4; image++){
    timestamp = millis();  
    // Goes through each row (total of [28-Rows * 28-Pixel])     
    for (unsigned int row = 0; row < 28; row++){
      // Feedfowards individually each pixel of an image, and then: returns the output(s).
      for (unsigned int pixel=0; pixel < 28;  pixel++){
        output = NN.FeedForward_Individual(pgm_read_byte(&handwritten[image][row][pixel]) / 255.0); // (255 is used to normalize pixels between [0,1])
      }
    }
    // Prints the most probable Output (maxOutput) and afterwards it resets the internal hidden-states of the RNN (resetStates) for the next image
    Serial.println((String)"Predicted [" + (maxOutput()) + "] - Under " + (millis() - timestamp) + " milliseconds.");
    NN.resetStates();
  }
}
void loop(){}



