/*
  Trained via Tensorflow: 22 epochs | 472 parameters (bytes)
  Testing  accuracy: 0.9216 - loss: 0.2626
  Training accuracy: 0.9186 - loss: 0.2724

  Source: https://github.com/GiorgosXou/ATTiny85-MNIST-RNN-EEPROM
*/

#define NumberOf(arg) ((unsigned int) (sizeof (arg) / sizeof (arg [0]))) // calculates the number of layers (in this case 3)
#define _1_OPTIMIZE 0B11011010 // https://github.com/GiorgosXou/NeuralNetworks#define-macro-properties
#define _2_OPTIMIZE 0B00100100 // MULTIPLE_BIASES_PER_LAYER + int8_t quantization
#define Q_FLOAT_RANGE 2.0      // Our Float32 weights are in the range of [-1,1]
#define USE_RNN__NB            // Makes (vanilla)-RNN the core-architecture of your NeuralNetwork. (NB = NO_BACKPROP support)
#define SELU                   // Defines core activation-function of your NeuralNetwork.
#include <NeuralNetwork.h>


// Images of handwritten Numbers\Digits in byte form. 
const PROGMEM byte handwritten[4][28][28] = { 
{ // NUMBER: 4
    {0,0,0,0, 0,  0,  0,  0,  0,  0,  0,  0,  0,  0,  0,  0,  0,  0,  0,  0,  0,  0,  0,  0, 0,0,0,0},
    {0,0,0,0, 0,  0,  0,  0,  0,  0,  0,  0,  0,  0,  0,  0,  0,  0,  0,  0,  0,  0,  0,  0, 0,0,0,0},
    {0,0,0,0, 0,  0,  0,  0,  0,  0,  0,  0,  0,  0,  0,  0,  0,  0,  0,  0,  0,  0,  0,  0, 0,0,0,0},
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    {0,0,0,0, 0,  0,  0,  0,  0,  0,  0,  0,  0,  0,  0,  0,  0,  0,  0,  0,  0,  0,  0,  0, 0,0,0,0},
},
{ // NUMBER: 7
    {0,0,0,0, 0,  0,  0,  0,  0,  0,  0,  0,  0,  0,  0,  0,  0,  0,  0,  0,  0,  0,  0,  0, 0,0,0,0},
    {0,0,0,0, 0,  0,  0,  0,  0,  0,  0,  0,  0,  0,  0,  0,  0,  0,  0,  0,  0,  0,  0,  0, 0,0,0,0},
    {0,0,0,0, 0,  0,  0,  0,  0,  0,  0,  0,  0,  0,  0,  0,  0,  0,  0,  0,  0,  0,  0,  0, 0,0,0,0},
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    {0,0,0,0, 0,  0, 57,252,252,  0,  0,  0,  0,  0,  0,  0,  0,  0,  0,  0,  0,  0,  0,  0, 0,0,0,0},  
},
{ // NUMBER: 0
    {0,0,0,0, 0,  0,  0,  0,  0,  0,  0,  0,  0,  0,  0,  0,  0,  0,  0,  0,  0,  0,  0,  0, 0,0,0,0,},
    {0,0,0,0, 0,  0,  0,  0,  0,  0,  0,  0,  0,  0,  0,  0,  0,  0,  0,  0,  0,  0,  0,  0, 0,0,0,0,},
    {0,0,0,0, 0,  0,  0,  0,  0,  0,  0,  0,  0,  0,  0,  0,  0,  0,  0,  0,  0,  0,  0,  0, 0,0,0,0,},
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    {0,0,0,0, 0,  0,  0,  0,  0,  0,  0,  0,  0,  0,  0,  0,  0,  0,  0,  0,  0,  0,  0,  0, 0,0,0,0,}
},
{ // NUMBER: 3
    {0,0,0,0, 0,  0,  0,  0,  0,  0,  0,  0,  0,  0,  0,  0,  0,  0,  0,  0,  0,  0,  0,  0, 0,0,0,0},
    {0,0,0,0, 0,  0,  0,  0,  0,  0,  0,  0,  0,  0,  0,  0,  0,  0,  0,  0,  0,  0,  0,  0, 0,0,0,0},
    {0,0,0,0, 0,  0,  0,  0,  0,  0,  0,  0,  0,  0,  0,  0,  0,  0,  0,  0,  0,  0,  0,  0, 0,0,0,0},
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    {0,0,0,0, 0,  0,  0,  0,  0,  0,  0,  0,  0,  0,  0,  0,  0,  0,  0,  0,  0,  0,  0,  0, 0,0,0,0}, 
},
}; // ^^^^^^ (images*(rows*pixels)) = (4*(28*28)) = 3136 Bytes 


// Pretrained int-quantized biases
const PROGMEM int8_t biases[] = {
 -2  , 59 ,-22 ,-99 , 35 ,
  21 ,-120,-16 , 4  ,-1  ,-38 , 3  ,-73 ,
 -127, 27 ,-60 , 78 ,-55 ,-4  ,-120,-69 ,-113,-19 ,
};

// Pretrained int-quantized weights
const PROGMEM int8_t weights[] = {
  // Layer 0 -> 1
 -127, 109, 12 , 51 , 11 , 14 , 14 , 22 , 26 , 26 , 32 , 39 , 51 , 59 , 54 , 53 , 42 , 30 , 26 , 18 , 20 , 10 , 16 , 12 , 4  ,-2  , 51 , 87 ,
  73 ,-32 , 7  , 28 ,-20 ,
  72 ,-127, 78 ,-59 ,-80 ,-97 ,-86 ,-112,-100,-98 ,-110,-105,-108,-76 ,-71 ,-57 ,-61 ,-62 ,-47 ,-48 ,-47 ,-43 ,-40 ,-57 ,-109,-57 ,-87 , 127,
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  56 ,-30 ,-6  ,-22 ,-54 ,

  // Layer 1 -> 2
 -40 , 123,-72 ,-16 ,-127,
  7  , 41 ,-5  ,-63 , 66 ,-9  ,-19 ,-19 ,
 -3  ,-32 ,-5  ,-65 , 19 ,
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  5  ,-68 ,-70 , 14 , 86 ,-99 ,-57 , 83 ,

  // Layer 2 -> 3
 -5  ,-25 ,-13 ,-30 ,-30 ,-42 ,-41 ,-19 ,
  112,-16 , 13 ,-25 , 12 , 34 ,-21 ,-13 , 36 ,-43 ,
  18 ,-113,-12 , 0  ,-59 ,-117,-13 ,-97 ,
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  48 , 9  ,-21 , 31 , 5  ,-26 ,-58 ,-20 ,-11 , 109,
};

const unsigned int layers[] = {28, 5, 8, 10};
float *output; // 4th layer's output(s)

unsigned long timestamp;


unsigned int maxOutput(){
  unsigned int maxi=0;
  for (unsigned int i = 0; i < 10; i++)
    if (output[i] > output[maxi])
      maxi = i;
  return maxi;
}


void setup()
{
  Serial.begin(9600);
  while (!Serial){ };

  // Creating a NeuralNetwork with pretrained Weights and Biases
  NeuralNetwork NN(layers, weights, biases, NumberOf(layers));
  //Goes through each image
  for (unsigned int image = 0; image < 4; image++){
    timestamp = millis();  
    // Goes through each row (total of [28-Rows * 28-Pixel])     
    for (unsigned int row = 0; row < 28; row++){
      // Feedfowards individually each pixel of an image, and then: returns the output(s).
      for (unsigned int pixel=0; pixel < 28;  pixel++){
        output = NN.FeedForward_Individual(pgm_read_byte(&handwritten[image][row][pixel]) / 255.0); // (255 is used to normalize pixels between [0,1])
      }
    }
    // Prints the most probable Output (maxOutput) and afterwards it resets the internal hidden-states of the RNN (resetStates) for the next image
    Serial.println((String)"Predicted [" + (maxOutput()) + "] - Under " + (millis() - timestamp) + " milliseconds.");
    NN.resetStates();
  }
}
void loop(){}



